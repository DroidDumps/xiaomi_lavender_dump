/dts-v1/;

/ {
	compatible = "qcom,sdm660-mtp\0qcom,sdm660\0qcom,mtp";
	model = "Qualcomm Technologies, Inc. SDM 660 PM660 + PM660L MTP F7A overlay";
	qcom,board-id = <0x20008 0x00>;
	qcom,pmic-id = <0x1001b 0x101011a 0x00 0x00 0x1001b 0x201011a 0x00 0x00 0x1001b 0x102001a 0x00 0x00>;

	__fixups__ {
		slim_aud = "/fragment@0:target:0";
	};

	fragment@0 {
		target = <0xffffffff>;

		__overlay__ {
			status = "disabled";
		};
	};
};
